// Definitions for ak4554vt (ak4554)
/dts-v1/;
/plugin/;

/ {
	compatible = "brcm,bcm2708"; //Sets compatibility with Broadcom Driver 2708

		fragment@0 {							//Defines "sound" node
			target = <&sound>;
			__overlay__{						//Defines .compatible resource name in ak455.c
			compatible = "asahi-kasei, ak4554";
			};
		};
	};
